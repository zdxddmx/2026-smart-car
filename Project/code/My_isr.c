#include "zf_common_headfile.h"

//由于逐飞的STC32G的库更新，导致我们不能再像前几届老库一样，直接把相关的函数塞到ISR.C里，但是现在这种方式又显得繁琐
//之前是只开个中断就好了，现在又要调用pit_ms_init,又要调优先级，最后还有设置回调函数
//然后中断的实际执行是通过标志位进入的，居然在主函数里用pit_state,这很大程序上会影响新手对于主循环和中断的理解
//所以基于此，考虑到定时器中断，又不想主函数越塞越多，干脆直接在这个文件中进行封装，在其他地方调用-------------------ORRN




///////////////////////////////////////////////////////////////////////////////////////////定时器0//////////////////////////////////////////////////////////////////////////////////////////////////////

uint8 pit_0_state = 0;
int32 TIME_1=0;

void pit_0_ms_init(int Time)
{
    pit_ms_init(TIM0_PIT,Time);                          	// 初始化 PIT_CH0 为周期中断
    interrupt_set_priority(TIMER0_IRQn,1);            		// 设置 PIT1 对周期中断的中断优先级为 1，0为最低优先级 
		tim0_irq_handler = pit_0_handler;											// 设置定时器0周期中断回调函数	
}



//-------------------------------------------------------------------------------------------------------------------
// 函数简介     PIT 的周期中断处理函数 这个函数将在 PIT 对应的定时器中断调用 详见 isr.c
// 参数说明     void
// 返回参数     void
// 使用示例     pit_handler();
//-------------------------------------------------------------------------------------------------------------------
void pit_0_handler (void)
{
    pit_0_state = 1;                                                              // 周期中断触发 标志位置位
}



///////////////////////////////////////////////////////////////////////////////////////////定时器1//////////////////////////////////////////////////////////////////////////////////////////////////////


uint8 pit_1_state = 0;

void pit_1_ms_init(int Time)
{
		tim1_irq_handler = pit_1_handler;											// 设置定时器0周期中断回调函数	
    pit_ms_init(TIM1_PIT,Time);                          	// 初始化 PIT_CH0 为周期中断
//    interrupt_set_priority(TIMER1_IRQn,0);            		// TIM1的中断优先级默认最低，不可修改，具体看手册。
}



//-------------------------------------------------------------------------------------------------------------------
// 函数简介     PIT 的周期中断处理函数 这个函数将在 PIT 对应的定时器中断调用 详见 isr.c
// 参数说明     void
// 返回参数     void
// 使用示例     pit_handler();
//-------------------------------------------------------------------------------------------------------------------
void pit_1_handler (void)
{
		TIME_1++;
	
		if(TIME_1%10==0)
		{
				gpio_toggle_level(IO_P52);//每10ms反转一次,LED闪烁,便于检查是否中断卡死
		}

		Imu_value_get();				//陀螺仪数据获取
		Dir_encoder_pulse_get();//编码器数据获取
		Read_adc();							//ADC数据获取
		
		if(PITCH.Pitch_1>30&&PITCH.Pitch_1<=360)//遇到桶或者墙壁负压拉到8000
		{
//				NEG_motor_ctrl(7000,50);
		}
		else
		{
				NEG_motor_ctrl(5000,50);	//负压电机先启动		
		}
		
		
		

		if(TIME_1>=400)					//2S后开始跑
		{
				A_navigation();//电磁导航基础控制
		}
		
		if(gpio_get_level(IO_P11)==1)//遥控器急停
		{
			while(1)
			{
					gpio_set_level(Buzzer_pin,1);//响	
					DRV8701_D_motor_ctrl(0,0);
					FY_S_motor_ctrl(0);

			}
		}
		


}
